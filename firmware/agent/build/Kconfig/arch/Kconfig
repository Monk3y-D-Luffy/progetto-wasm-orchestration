## firmware/agent/build/Kconfig/arch/Kconfig
```kconfig
# Load Zephyr Arch Kconfig descriptions.
osource "C:/Users/Salvo/stm32-wasm-runtime-benchmarks/zephyrproject/zephyr/arch/rx/Kconfig"
osource "C:/Users/Salvo/stm32-wasm-runtime-benchmarks/zephyrproject/zephyr/arch/x86/Kconfig"
osource "C:/Users/Salvo/stm32-wasm-runtime-benchmarks/zephyrproject/zephyr/arch/xtensa/Kconfig"
osource "C:/Users/Salvo/stm32-wasm-runtime-benchmarks/zephyrproject/zephyr/arch/sparc/Kconfig"
osource "C:/Users/Salvo/stm32-wasm-runtime-benchmarks/zephyrproject/zephyr/arch/riscv/Kconfig"
osource "C:/Users/Salvo/stm32-wasm-runtime-benchmarks/zephyrproject/zephyr/arch/posix/Kconfig"
osource "C:/Users/Salvo/stm32-wasm-runtime-benchmarks/zephyrproject/zephyr/arch/mips/Kconfig"
osource "C:/Users/Salvo/stm32-wasm-runtime-benchmarks/zephyrproject/zephyr/arch/arm64/Kconfig"
osource "C:/Users/Salvo/stm32-wasm-runtime-benchmarks/zephyrproject/zephyr/arch/arm/Kconfig"
osource "C:/Users/Salvo/stm32-wasm-runtime-benchmarks/zephyrproject/zephyr/arch/arc/Kconfig"
```

## firmware/agent/build/Kconfig/boards/Kconfig
```kconfig
# Load Zephyr board Kconfig descriptions.
osource "C:/Users/Salvo/stm32-wasm-runtime-benchmarks/zephyrproject/zephyr/boards/st/nucleo_f446re/Kconfig"
```

## firmware/agent/build/Kconfig/boards/Kconfig.defconfig
```kconfig
# Load Zephyr board defconfig descriptions.
osource "C:/Users/Salvo/stm32-wasm-runtime-benchmarks/zephyrproject/zephyr/boards/st/nucleo_f446re/Kconfig.defconfig"
```

## firmware/agent/build/Kconfig/boards/Kconfig.nucleo_f446re
```kconfig
# Load board Kconfig descriptions.
osource "C:/Users/Salvo/stm32-wasm-runtime-benchmarks/zephyrproject/zephyr/boards/st/nucleo_f446re/Kconfig.nucleo_f446re"
```
